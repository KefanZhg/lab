## CMakeLists.txt
```
#
# Copyright (c) 2021 Nordic Semiconductor ASA
#
# SPDX-License-Identifier: LicenseRef-Nordic-5-Clause
#

cmake_minimum_required(VERSION 3.20.0)

find_package(Zephyr HINTS $ENV{ZEPHYR_BASE})

project(matter-light-switch)

# Enable GNU STD support.
include(${ZEPHYR_CONNECTEDHOMEIP_MODULE_DIR}/config/nrfconnect/app/enable-gnu-std.cmake)

# NORDIC SDK APP START

# Include all source files that are located in the Matter common directory.
include(${ZEPHYR_NRF_MODULE_DIR}/samples/matter/common/cmake/source_common.cmake)

# Include Data Model utils
include(${ZEPHYR_NRF_MODULE_DIR}/samples/matter/common/cmake/data_model.cmake)

include(${ZEPHYR_NRF_MODULE_DIR}/samples/matter/common/cmake/zap_helpers.cmake)
ncs_get_zap_parent_dir(ZAP_PARENT_DIR)

target_include_directories(app PRIVATE
  src
  ${ZAP_PARENT_DIR}
)

target_compile_options(app PRIVATE -Wno-deprecated-declarations)

target_sources(app PRIVATE
  src/app_task.cpp
  src/light_switch.cpp
  src/main.cpp
  src/shell_commands.cpp
  ${ZEPHYR_NRF_MODULE_DIR}/samples/matter/common/src/binding/binding_handler.cpp
)

ncs_configure_data_model()

# Firmware identity block (git hash, version, CRC)
get_filename_component(_real_src "${CMAKE_CURRENT_SOURCE_DIR}" REALPATH)
include(${_real_src}/../common/fw_info/fw_info.cmake)

# NORDIC SDK APP END
```

## prj.conf
```kconfig
#
# Copyright (c) 2021 Nordic Semiconductor ASA
#
# SPDX-License-Identifier: LicenseRef-Nordic-5-Clause
#

# Enable CHIP
CONFIG_CHIP=y
CONFIG_CHIP_PROJECT_CONFIG="src/chip_project_config.h"
CONFIG_CHIP_DEVICE_PRODUCT_NAME="Matter Light Switch"

# Configure ZAP file name
CONFIG_NCS_SAMPLE_MATTER_ZAP_FILE_PATH="${APPLICATION_CONFIG_DIR}/src/default_zap/light_switch.zap"

# 32772 == 0x8004 (example light-switch-app)
CONFIG_CHIP_DEVICE_PRODUCT_ID=32772
CONFIG_STD_CPP17=y

# Enable Matter pairing automatically on application start.
CONFIG_CHIP_ENABLE_PAIRING_AUTOSTART=y

# Enable Matter extended announcement and increase duration to 1 hour.
CONFIG_CHIP_BLE_EXT_ADVERTISING=y
CONFIG_CHIP_BLE_ADVERTISING_DURATION=60

# Add support for LEDs and buttons on Nordic development kits
CONFIG_DK_LIBRARY=y

# Bluetooth Low Energy configuration
CONFIG_BT_DEVICE_NAME="MatterSwitch"

# Suspend devices when the CPU goes into sleep
CONFIG_PM_DEVICE=y

# Other settings
CONFIG_THREAD_NAME=y
CONFIG_MPU_STACK_GUARD=y
CONFIG_RESET_ON_FATAL_ERROR=n
CONFIG_CHIP_LIB_SHELL=y
CONFIG_NCS_SAMPLE_MATTER_TEST_SHELL=y
CONFIG_OPENTHREAD_SHELL=y

# Reduce application size
CONFIG_USE_SEGGER_RTT=n

# Enable Factory Data feature
CONFIG_CHIP_FACTORY_DATA=y
CONFIG_CHIP_FACTORY_DATA_BUILD=y
```

## src/app_task.cpp
```c
/*
 * Copyright (c) 2022 Nordic Semiconductor ASA
 *
 * SPDX-License-Identifier: LicenseRef-Nordic-5-Clause
 */

#include "app_task.h"

#include "light_switch.h"

#include "app/matter_init.h"
#include "app/task_executor.h"
#include "board/board.h"
#include "clusters/identify.h"

#include <setup_payload/OnboardingCodesUtil.h>

#include <zephyr/logging/log.h>

LOG_MODULE_DECLARE(app, CONFIG_CHIP_APP_LOG_LEVEL);

using namespace ::chip;
using namespace ::chip::app;
using namespace ::chip::DeviceLayer;

namespace
{
constexpr uint32_t kDimmerTriggeredTimeout = 500;
constexpr uint32_t kDimmerInterval = 300;

/* EP1 = BTN2, EP2 = BTN3, EP3 = BTN4 */
struct ButtonCtx {
	k_timer dimmerTriggerTimer;
	k_timer dimmerTimer;
	EndpointId ep;
	bool wasDimmerTriggered;
};

static ButtonCtx sBtn[3];

Nrf::Matter::IdentifyCluster sIdentifyCluster(1 /* EP1 */);
} /* namespace */

static ButtonCtx *CtxFromTimer(k_timer *timer)
{
	for (auto &ctx : sBtn) {
		if (timer == &ctx.dimmerTriggerTimer || timer == &ctx.dimmerTimer) {
			return &ctx;
		}
	}
	return nullptr;
}

static void DimmerTriggerTimeoutCallback(k_timer *timer)
{
	ButtonCtx *ctx = CtxFromTimer(timer);
	if (!ctx) {
		return;
	}
	EndpointId ep = ctx->ep;
	Nrf::PostTask([ep]() {
		/* Find the ctx again inside the task (safe: sBtn is static) */
		ButtonCtx *c = nullptr;
		for (auto &b : sBtn) {
			if (b.ep == ep) { c = &b; break; }
		}
		if (!c) return;

		LOG_INF("Dimming started on EP%u...", ep);
		c->wasDimmerTriggered = true;
		LightSwitch::GetInstance().InitiateActionSwitch(ep, LightSwitch::Action::On);
		k_timer_start(&c->dimmerTimer, K_MSEC(kDimmerInterval), K_MSEC(kDimmerInterval));
		k_timer_stop(&c->dimmerTriggerTimer);
	});
}

static void DimmerTimeoutCallback(k_timer *timer)
{
	ButtonCtx *ctx = CtxFromTimer(timer);
	if (!ctx) {
		return;
	}
	EndpointId ep = ctx->ep;
	Nrf::PostTask([ep]() {
		LightSwitch::GetInstance().DimmerChangeBrightness(ep);
	});
}

static void HandleButtonRelease(ButtonCtx *ctx)
{
	EndpointId ep = ctx->ep;
	Nrf::PostTask([ep]() {
		ButtonCtx *c = nullptr;
		for (auto &b : sBtn) {
			if (b.ep == ep) { c = &b; break; }
		}
		if (!c) return;

		if (!c->wasDimmerTriggered) {
			LightSwitch::GetInstance().InitiateActionSwitch(ep, LightSwitch::Action::Toggle);
		}
		k_timer_stop(&c->dimmerTimer);
		k_timer_stop(&c->dimmerTriggerTimer);
		c->wasDimmerTriggered = false;
	});
}

void AppTask::ButtonEventHandler(Nrf::ButtonState state, Nrf::ButtonMask hasChanged)
{
	/* BTN2 → EP1 */
	if (DK_BTN2_MSK & hasChanged) {
		if (DK_BTN2_MSK & state) {
			LOG_INF("BTN2 pressed (EP1)");
			k_timer_start(&sBtn[0].dimmerTriggerTimer, K_MSEC(kDimmerTriggeredTimeout), K_NO_WAIT);
		} else {
			HandleButtonRelease(&sBtn[0]);
		}
	}

	/* BTN3 → EP2 */
	if (DK_BTN3_MSK & hasChanged) {
		if (DK_BTN3_MSK & state) {
			LOG_INF("BTN3 pressed (EP2)");
			k_timer_start(&sBtn[1].dimmerTriggerTimer, K_MSEC(kDimmerTriggeredTimeout), K_NO_WAIT);
		} else {
			HandleButtonRelease(&sBtn[1]);
		}
	}

	/* BTN4 → EP3 */
	if (DK_BTN4_MSK & hasChanged) {
		if (DK_BTN4_MSK & state) {
			LOG_INF("BTN4 pressed (EP3)");
			k_timer_start(&sBtn[2].dimmerTriggerTimer, K_MSEC(kDimmerTriggeredTimeout), K_NO_WAIT);
		} else {
			HandleButtonRelease(&sBtn[2]);
		}
	}
}

CHIP_ERROR AppTask::Init()
{
	/* Initialize Matter stack */
	ReturnErrorOnFailure(Nrf::Matter::PrepareServer(Nrf::Matter::InitData{ .mPostServerInitClbk = [] {
		LightSwitch::GetInstance().Init(1 /* EP1 */);
		return CHIP_NO_ERROR;
	} }));

	/* Initialize per-button contexts and timers */
	sBtn[0] = { .ep = 1, .wasDimmerTriggered = false };
	sBtn[1] = { .ep = 2, .wasDimmerTriggered = false };
	sBtn[2] = { .ep = 3, .wasDimmerTriggered = false };

	for (auto &ctx : sBtn) {
		k_timer_init(&ctx.dimmerTriggerTimer, DimmerTriggerTimeoutCallback, nullptr);
		k_timer_init(&ctx.dimmerTimer, DimmerTimeoutCallback, nullptr);
	}

	if (!Nrf::GetBoard().Init(ButtonEventHandler)) {
		LOG_ERR("User interface initialization failed.");
		return CHIP_ERROR_INCORRECT_STATE;
	}

	ReturnErrorOnFailure(Nrf::Matter::RegisterEventHandler(Nrf::Board::DefaultMatterEventHandler, 0));

	ReturnErrorOnFailure(sIdentifyCluster.Init());

	return Nrf::Matter::StartServer();
}

CHIP_ERROR AppTask::StartApp()
{
	ReturnErrorOnFailure(Init());

	while (true) {
		Nrf::DispatchNextTask();
	}

	return CHIP_NO_ERROR;
}
```

## src/app_task.h
```c
/*
 * Copyright (c) 2022 Nordic Semiconductor ASA
 *
 * SPDX-License-Identifier: LicenseRef-Nordic-5-Clause
 */

#pragma once

#include "board/board.h"

#include <platform/CHIPDeviceLayer.h>

class AppTask {
public:
	static AppTask &Instance()
	{
		static AppTask sAppTask;
		return sAppTask;
	};

	CHIP_ERROR StartApp();

private:
	CHIP_ERROR Init();

	static void ButtonEventHandler(Nrf::ButtonState state, Nrf::ButtonMask hasChanged);
};
```

## src/light_switch.cpp
```c
/*
 * Copyright (c) 2022 Nordic Semiconductor ASA
 *
 * SPDX-License-Identifier: LicenseRef-Nordic-5-Clause
 */

#include "light_switch.h"
#include "binding/binding_handler.h"

#ifdef CONFIG_CHIP_LIB_SHELL
#include "shell_commands.h"
#endif

#include <app/clusters/bindings/binding-table.h>
#include <app/server/Server.h>
#include <controller/InvokeInteraction.h>
#include <platform/CHIPDeviceLayer.h>
#include <zephyr/logging/log.h>

using namespace chip;
using namespace chip::app;
using namespace chip::app::Clusters;

LOG_MODULE_DECLARE(app, CONFIG_CHIP_APP_LOG_LEVEL);

void LightSwitch::Init(chip::EndpointId lightSwitchEndpoint)
{
	Nrf::Matter::BindingHandler::Init();
#ifdef CONFIG_CHIP_LIB_SHELL
	SwitchCommands::RegisterSwitchCommands();
#endif
	mLightSwitchEndpoint = lightSwitchEndpoint;
}

void LightSwitch::InitiateActionSwitch(Action action)
{
	InitiateActionSwitch(mLightSwitchEndpoint, action);
}

void LightSwitch::InitiateActionSwitch(chip::EndpointId ep, Action action)
{
	Nrf::Matter::BindingHandler::BindingData *data = Platform::New<Nrf::Matter::BindingHandler::BindingData>();
	if (data) {
		data->EndpointId = ep;
		data->ClusterId = Clusters::OnOff::Id;
		data->InvokeCommandFunc = SwitchChangedHandler;
		switch (action) {
		case Action::Toggle:
			data->CommandId = Clusters::OnOff::Commands::Toggle::Id;
			break;
		case Action::On:
			data->CommandId = Clusters::OnOff::Commands::On::Id;
			break;
		case Action::Off:
			data->CommandId = Clusters::OnOff::Commands::Off::Id;
			break;
		default:
			Platform::Delete(data);
			return;
		}
		Nrf::Matter::BindingHandler::RunBoundClusterAction(data);
	}
}

void LightSwitch::DimmerChangeBrightness()
{
	DimmerChangeBrightness(mLightSwitchEndpoint);
}

void LightSwitch::DimmerChangeBrightness(chip::EndpointId ep)
{
	static uint16_t sBrightness[4];
	uint8_t idx = (ep < 4) ? ep : 0;
	Nrf::Matter::BindingHandler::BindingData *data = Platform::New<Nrf::Matter::BindingHandler::BindingData>();
	if (data) {
		data->EndpointId = ep;
		data->CommandId = Clusters::LevelControl::Commands::MoveToLevel::Id;
		data->ClusterId = Clusters::LevelControl::Id;
		data->InvokeCommandFunc = SwitchChangedHandler;
		sBrightness[idx] += kOnePercentBrightnessApproximation;
		if (sBrightness[idx] > kMaximumBrightness) {
			sBrightness[idx] = 0;
		}
		data->Value = (uint8_t)sBrightness[idx];
		Nrf::Matter::BindingHandler::RunBoundClusterAction(data);
	}
}

void LightSwitch::SwitchChangedHandler(const Binding::TableEntry &binding, OperationalDeviceProxy *deviceProxy,
				       Nrf::Matter::BindingHandler::BindingData &bindingData)
{
	if (binding.type == Binding::MATTER_MULTICAST_BINDING) {
		switch (bindingData.ClusterId) {
		case Clusters::OnOff::Id:
			OnOffProcessCommand(bindingData.CommandId, binding, nullptr, bindingData);
			break;
		case Clusters::LevelControl::Id:
			LevelControlProcessCommand(bindingData.CommandId, binding, nullptr, bindingData);
			break;
		default:
			ChipLogError(NotSpecified, "Invalid binding group command data");
			break;
		}
	} else if (binding.type == Binding::MATTER_UNICAST_BINDING) {
		switch (bindingData.ClusterId) {
		case Clusters::OnOff::Id:
			OnOffProcessCommand(bindingData.CommandId, binding, deviceProxy, bindingData);
			break;
		case Clusters::LevelControl::Id:
			LevelControlProcessCommand(bindingData.CommandId, binding, deviceProxy, bindingData);
			break;
		default:
			ChipLogError(NotSpecified, "Invalid binding unicast command data");
			break;
		}
	}
}

void LightSwitch::OnOffProcessCommand(CommandId commandId, const Binding::TableEntry &binding,
				      OperationalDeviceProxy *device,
				      Nrf::Matter::BindingHandler::BindingData &bindingData)
{
	CHIP_ERROR ret = CHIP_NO_ERROR;

	auto onSuccess = [dataPointer = Platform::New<Nrf::Matter::BindingHandler::BindingData>(bindingData)](
				 const ConcreteCommandPath &commandPath, const StatusIB &status,
				 const auto &dataResponse) {
		Nrf::Matter::BindingHandler::OnInvokeCommandSucces(dataPointer);
	};

	auto onFailure = [dataPointer = Platform::New<Nrf::Matter::BindingHandler::BindingData>(bindingData)](
				 CHIP_ERROR aError) mutable {
		Nrf::Matter::BindingHandler::OnInvokeCommandFailure(dataPointer, aError);
	};

	if (device) {
		/* We are validating connection is ready once here instead of multiple times in each case
		 * statement below. */
		VerifyOrDie(device->ConnectionReady());
	}

	switch (commandId) {
	case Clusters::OnOff::Commands::Toggle::Id:
		Clusters::OnOff::Commands::Toggle::Type toggleCommand;
		if (device) {
			ret = Controller::InvokeCommandRequest(device->GetExchangeManager(),
							       device->GetSecureSession().Value(), binding.remote,
							       toggleCommand, onSuccess, onFailure);
		} else {
			Messaging::ExchangeManager &exchangeMgr = Server::GetInstance().GetExchangeManager();
			ret = Controller::InvokeGroupCommandRequest(&exchangeMgr, binding.fabricIndex, binding.groupId,
								    toggleCommand);
		}
		break;

	case Clusters::OnOff::Commands::On::Id:
		Clusters::OnOff::Commands::On::Type onCommand;
		if (device) {
			ret = Controller::InvokeCommandRequest(device->GetExchangeManager(),
							       device->GetSecureSession().Value(), binding.remote,
							       onCommand, onSuccess, onFailure);
		} else {
			Messaging::ExchangeManager &exchangeMgr = Server::GetInstance().GetExchangeManager();
			ret = Controller::InvokeGroupCommandRequest(&exchangeMgr, binding.fabricIndex, binding.groupId,
								    onCommand);
		}
		break;

	case Clusters::OnOff::Commands::Off::Id:
		Clusters::OnOff::Commands::Off::Type offCommand;
		if (device) {
			ret = Controller::InvokeCommandRequest(device->GetExchangeManager(),
							       device->GetSecureSession().Value(), binding.remote,
							       offCommand, onSuccess, onFailure);
		} else {
			Messaging::ExchangeManager &exchangeMgr = Server::GetInstance().GetExchangeManager();
			ret = Controller::InvokeGroupCommandRequest(&exchangeMgr, binding.fabricIndex, binding.groupId,
								    offCommand);
		}
		break;
	default:
		LOG_DBG("Invalid binding command data - commandId is not supported");
		break;
	}
	if (CHIP_NO_ERROR != ret) {
		LOG_ERR("Invoke OnOff Command Request ERROR: %s", ErrorStr(ret));
	}
}

void LightSwitch::LevelControlProcessCommand(CommandId commandId, const Binding::TableEntry &binding,
					     OperationalDeviceProxy *device,
					     Nrf::Matter::BindingHandler::BindingData &bindingData)
{
	auto onSuccess = [dataPointer = Platform::New<Nrf::Matter::BindingHandler::BindingData>(bindingData)](
				 const ConcreteCommandPath &commandPath, const StatusIB &status,
				 const auto &dataResponse) {
		Nrf::Matter::BindingHandler::OnInvokeCommandSucces(dataPointer);
	};

	auto onFailure = [dataPointer = Platform::New<Nrf::Matter::BindingHandler::BindingData>(bindingData)](
				 CHIP_ERROR aError) mutable {
		Nrf::Matter::BindingHandler::OnInvokeCommandFailure(dataPointer, aError);
	};

	CHIP_ERROR ret = CHIP_NO_ERROR;

	if (device) {
		/* We are validating connection is ready once here instead of multiple times in each case
		 * statement below.
		 */
		VerifyOrDie(device->ConnectionReady());
	}

	switch (commandId) {
	case Clusters::LevelControl::Commands::MoveToLevel::Id: {
		Clusters::LevelControl::Commands::MoveToLevel::Type moveToLevelCommand;
		moveToLevelCommand.level = bindingData.Value;
		if (device) {
			ret = Controller::InvokeCommandRequest(device->GetExchangeManager(),
							       device->GetSecureSession().Value(), binding.remote,
							       moveToLevelCommand, onSuccess, onFailure);
		} else {
			Messaging::ExchangeManager &exchangeMgr = Server::GetInstance().GetExchangeManager();
			ret = Controller::InvokeGroupCommandRequest(&exchangeMgr, binding.fabricIndex, binding.groupId,
								    moveToLevelCommand);
		}
	} break;
	default:
		LOG_DBG("Invalid binding command data - commandId is not supported");
		break;
	}
	if (CHIP_NO_ERROR != ret) {
		LOG_ERR("Invoke Group Command Request ERROR: %s", ErrorStr(ret));
	}
}
```

## src/light_switch.h
```c
/*
 * Copyright (c) 2022 Nordic Semiconductor ASA
 *
 * SPDX-License-Identifier: LicenseRef-Nordic-5-Clause
 */

#pragma once
#include <app/util/basic-types.h>
#include <lib/core/CHIPError.h>

#include "binding/binding_handler.h"

#include <atomic>

/** @class LightSwitch
 *  @brief Class for controlling a CHIP light bulb over a Thread network
 *
 *  Features:
 *  - discovering a CHIP light bulb which advertises itself by sending Thread multicast packets
 *  - toggling and dimming the connected CHIP light bulb by sending appropriate CHIP messages
 */
class LightSwitch {
public:
	enum class Action : uint8_t {
		Toggle, /* Switch state on lighting-app device */
		On, /* Turn on light on lighting-app device */
		Off /* Turn off light on lighting-app device */
	};

	void Init(chip::EndpointId lightSwitchEndpoint);
	void InitiateActionSwitch(Action action);
	void InitiateActionSwitch(chip::EndpointId ep, Action action);
	void DimmerChangeBrightness();
	void DimmerChangeBrightness(chip::EndpointId ep);
	chip::EndpointId GetLightSwitchEndpointId() { return mLightSwitchEndpoint; }
	static void SwitchChangedHandler(const chip::app::Clusters::Binding::TableEntry &binding,
					 chip::OperationalDeviceProxy *deviceProxy,
					 Nrf::Matter::BindingHandler::BindingData &bindingData);

	static LightSwitch &GetInstance()
	{
		static LightSwitch sLightSwitch;
		return sLightSwitch;
	}

private:
	static void OnOffProcessCommand(chip::CommandId commandId,
					const chip::app::Clusters::Binding::TableEntry &binding,
					chip::OperationalDeviceProxy *device,
					Nrf::Matter::BindingHandler::BindingData &bindingData);
	static void LevelControlProcessCommand(chip::CommandId commandId,
					       const chip::app::Clusters::Binding::TableEntry &binding,
					       chip::OperationalDeviceProxy *device,
					       Nrf::Matter::BindingHandler::BindingData &bindingData);
	constexpr static auto kOnePercentBrightnessApproximation = 3;
	constexpr static auto kMaximumBrightness = 254;

	chip::EndpointId mLightSwitchEndpoint;
};
```

## src/shell_commands.cpp
```c
/*
 * Copyright (c) 2022 Nordic Semiconductor ASA
 *
 * SPDX-License-Identifier: LicenseRef-Nordic-5-Clause
 */

#include "shell_commands.h"
#include "binding/binding_handler.h"
#include "light_switch.h"

#include <app/clusters/bindings/binding-table.h>
#include <app/server/Server.h>
#include <platform/CHIPDeviceLayer.h>

#ifdef CONFIG_CHIP_LIB_SHELL

using namespace chip;
using namespace chip::app;

namespace SwitchCommands
{
using Shell::Engine;
using Shell::shell_command_t;
using Shell::streamer_get;
using Shell::streamer_printf;

Engine sShellSwitchSubCommands;
Engine sShellSwitchOnOffSubCommands;
Engine sShellSwitchGroupsSubCommands;
Engine sShellSwitchGroupsOnOffSubCommands;

static CHIP_ERROR SwitchHelpHandler(int argc, char **argv)
{
	sShellSwitchSubCommands.ForEachCommand(Shell::PrintCommandHelp, nullptr);
	return CHIP_NO_ERROR;
}

static CHIP_ERROR SwitchCommandHandler(int argc, char **argv)
{
	if (argc == 0) {
		return SwitchHelpHandler(argc, argv);
	}
	return sShellSwitchSubCommands.ExecCommand(argc, argv);
}

static CHIP_ERROR TableCommandHelper(int argc, char **argv)
{
	Nrf::Matter::BindingHandler::PrintBindingTable();
	return CHIP_NO_ERROR;
}

namespace Unicast
{
	static CHIP_ERROR OnOffHelpHandler(int argc, char **argv)
	{
		sShellSwitchOnOffSubCommands.ForEachCommand(Shell::PrintCommandHelp, nullptr);
		return CHIP_NO_ERROR;
	}

	static CHIP_ERROR OnOffCommandHandler(int argc, char **argv)
	{
		if (argc == 0) {
			return OnOffHelpHandler(argc, argv);
		}
		return sShellSwitchOnOffSubCommands.ExecCommand(argc, argv);
	}

	static CHIP_ERROR OnCommandHandler(int argc, char **argv)
	{
		Nrf::Matter::BindingHandler::BindingData *data =
			Platform::New<Nrf::Matter::BindingHandler::BindingData>();
		if (data) {
			data->EndpointId = LightSwitch::GetInstance().GetLightSwitchEndpointId();
			data->CommandId = Clusters::OnOff::Commands::On::Id;
			data->ClusterId = Clusters::OnOff::Id;
			data->InvokeCommandFunc = LightSwitch::SwitchChangedHandler;
			data->IsGroup.SetValue(false);

			Nrf::Matter::BindingHandler::RunBoundClusterAction(data);
			return CHIP_NO_ERROR;
		}
		return CHIP_ERROR_NO_MEMORY;
	}

	static CHIP_ERROR OffCommandHandler(int argc, char **argv)
	{
		Nrf::Matter::BindingHandler::BindingData *data =
			Platform::New<Nrf::Matter::BindingHandler::BindingData>();
		if (data) {
			data->EndpointId = LightSwitch::GetInstance().GetLightSwitchEndpointId();
			data->CommandId = Clusters::OnOff::Commands::Off::Id;
			data->ClusterId = Clusters::OnOff::Id;
			data->InvokeCommandFunc = LightSwitch::SwitchChangedHandler;
			data->IsGroup.SetValue(false);

			Nrf::Matter::BindingHandler::RunBoundClusterAction(data);
			return CHIP_NO_ERROR;
		}
		return CHIP_ERROR_NO_MEMORY;
	}

	static CHIP_ERROR ToggleCommandHandler(int argc, char **argv)
	{
		Nrf::Matter::BindingHandler::BindingData *data =
			Platform::New<Nrf::Matter::BindingHandler::BindingData>();
		if (data) {
			data->EndpointId = LightSwitch::GetInstance().GetLightSwitchEndpointId();
			data->CommandId = Clusters::OnOff::Commands::Toggle::Id;
			data->ClusterId = Clusters::OnOff::Id;
			data->InvokeCommandFunc = LightSwitch::SwitchChangedHandler;
			data->IsGroup.SetValue(false);

			Nrf::Matter::BindingHandler::RunBoundClusterAction(data);
			return CHIP_NO_ERROR;
		}
		return CHIP_ERROR_NO_MEMORY;
	}
} /* namespace Unicast */

namespace Group
{
	CHIP_ERROR SwitchHelpHandler(int argc, char **argv)
	{
		sShellSwitchGroupsSubCommands.ForEachCommand(Shell::PrintCommandHelp, nullptr);
		return CHIP_NO_ERROR;
	}

	CHIP_ERROR SwitchCommandHandler(int argc, char **argv)
	{
		if (argc == 0) {
			return SwitchHelpHandler(argc, argv);
		}

		return sShellSwitchGroupsSubCommands.ExecCommand(argc, argv);
	}

	static CHIP_ERROR OnOffHelpHandler(int argc, char **argv)
	{
		sShellSwitchGroupsOnOffSubCommands.ForEachCommand(Shell::PrintCommandHelp, nullptr);
		return CHIP_NO_ERROR;
	}

	static CHIP_ERROR OnOffCommandHandler(int argc, char **argv)
	{
		if (argc == 0) {
			return OnOffHelpHandler(argc, argv);
		}

		return sShellSwitchGroupsOnOffSubCommands.ExecCommand(argc, argv);
	}

	CHIP_ERROR OnCommandHandler(int argc, char **argv)
	{
		Nrf::Matter::BindingHandler::BindingData *data =
			Platform::New<Nrf::Matter::BindingHandler::BindingData>();
		if (data) {
			data->EndpointId = LightSwitch::GetInstance().GetLightSwitchEndpointId();
			data->CommandId = Clusters::OnOff::Commands::On::Id;
			data->ClusterId = Clusters::OnOff::Id;
			data->InvokeCommandFunc = LightSwitch::SwitchChangedHandler;
			data->IsGroup.SetValue(true);

			Nrf::Matter::BindingHandler::RunBoundClusterAction(data);
			return CHIP_NO_ERROR;
		}
		return CHIP_ERROR_NO_MEMORY;
	}

	CHIP_ERROR OffCommandHandler(int argc, char **argv)
	{
		Nrf::Matter::BindingHandler::BindingData *data =
			Platform::New<Nrf::Matter::BindingHandler::BindingData>();
		if (data) {
			data->EndpointId = LightSwitch::GetInstance().GetLightSwitchEndpointId();
			data->CommandId = Clusters::OnOff::Commands::Off::Id;
			data->ClusterId = Clusters::OnOff::Id;
			data->InvokeCommandFunc = LightSwitch::SwitchChangedHandler;
			data->IsGroup.SetValue(true);

			Nrf::Matter::BindingHandler::RunBoundClusterAction(data);
			return CHIP_NO_ERROR;
		}
		return CHIP_ERROR_NO_MEMORY;
	}

	CHIP_ERROR ToggleCommandHandler(int argc, char **argv)
	{
		Nrf::Matter::BindingHandler::BindingData *data =
			Platform::New<Nrf::Matter::BindingHandler::BindingData>();
		if (data) {
			data->EndpointId = LightSwitch::GetInstance().GetLightSwitchEndpointId();
			data->CommandId = Clusters::OnOff::Commands::Toggle::Id;
			data->ClusterId = Clusters::OnOff::Id;
			data->InvokeCommandFunc = LightSwitch::SwitchChangedHandler;
			data->IsGroup.SetValue(true);

			Nrf::Matter::BindingHandler::RunBoundClusterAction(data);
			return CHIP_NO_ERROR;
		}
		return CHIP_ERROR_NO_MEMORY;
	}

} /* namespace Group */

using BindingTable = chip::app::Clusters::Binding::Table;
using BindingEntry = chip::app::Clusters::Binding::TableEntry;

// 写入 unicast binding: switch bind <localEndpoint> <nodeId_hex> <remoteEndpoint>
// 示例: switch bind 1 0x1122334455667788 1
static CHIP_ERROR BindCommandHandler(int argc, char **argv)
{
	if (argc < 3) {
		streamer_printf(streamer_get(), "Usage: switch bind <localEp> <nodeId_hex> <remoteEp>\r\n");
		streamer_printf(streamer_get(), "Example: switch bind 1 0x1122334455667788 1\r\n");
		return CHIP_ERROR_INVALID_ARGUMENT;
	}

	chip::EndpointId localEp = (chip::EndpointId)strtoul(argv[0], nullptr, 0);
	chip::NodeId nodeId = (chip::NodeId)strtoull(argv[1], nullptr, 0);
	chip::EndpointId remoteEp = (chip::EndpointId)strtoul(argv[2], nullptr, 0);

	chip::FabricIndex fabricIndex = chip::kUndefinedFabricIndex;
	for (const chip::FabricInfo & fabric : chip::Server::GetInstance().GetFabricTable()) {
		fabricIndex = fabric.GetFabricIndex();
		break;
	}
	if (fabricIndex == chip::kUndefinedFabricIndex) {
		streamer_printf(streamer_get(), "Error: not commissioned yet\r\n");
		return CHIP_ERROR_INCORRECT_STATE;
	}

	// 清掉 localEp 上的旧 binding
	auto & table = BindingTable::GetInstance();
	for (auto iter = table.begin(); iter != table.end();) {
		if (iter->local == localEp) {
			table.RemoveAt(iter);
		} else {
			++iter;
		}
	}

	// OnOff binding
	BindingEntry onoffEntry(fabricIndex, nodeId, localEp, remoteEp,
				std::make_optional(chip::app::Clusters::OnOff::Id));
	CHIP_ERROR err = table.Add(onoffEntry);
	if (err != CHIP_NO_ERROR) {
		streamer_printf(streamer_get(), "Error adding OnOff binding: %s\r\n", chip::ErrorStr(err));
		return err;
	}

	// LevelControl binding
	BindingEntry levelEntry(fabricIndex, nodeId, localEp, remoteEp,
				std::make_optional(chip::app::Clusters::LevelControl::Id));
	err = table.Add(levelEntry);
	if (err != CHIP_NO_ERROR) {
		streamer_printf(streamer_get(), "Error adding LevelControl binding: %s\r\n", chip::ErrorStr(err));
		return err;
	}

	streamer_printf(streamer_get(), "Bound EP%u -> node 0x%llx EP%u (fabric %u)\r\n",
			localEp, (unsigned long long)nodeId, remoteEp, fabricIndex);
	return CHIP_NO_ERROR;
}

// 打印本机在各 fabric 上的 nodeId
static CHIP_ERROR NodesCommandHandler(int argc, char **argv)
{
	bool found = false;
	for (const chip::FabricInfo & fabric : chip::Server::GetInstance().GetFabricTable()) {
		streamer_printf(streamer_get(), "Fabric %u  MyNodeId: 0x%llx\r\n",
				fabric.GetFabricIndex(),
				(unsigned long long)fabric.GetNodeId());
		found = true;
	}
	if (!found) {
		streamer_printf(streamer_get(), "Not commissioned\r\n");
	}
	return CHIP_NO_ERROR;
}

void RegisterSwitchCommands()
{
	static const shell_command_t sSwitchSubCommands[] = {
		{ &SwitchHelpHandler, "help", "Switch commands" },
		{ &Unicast::OnOffCommandHandler, "onoff", "Usage: switch onoff [on|off|toggle]" },
		{ &Group::SwitchCommandHandler, "groups", "Usage: switch groups onoff [on|off|toggle]" },
		{ &TableCommandHelper, "table", "Print a binding table" },
		{ &BindCommandHandler, "bind", "Bind: switch bind <localEp> <nodeId_hex> <remoteEp>" },
		{ &NodesCommandHandler, "nodes", "List commissioned nodes on this fabric" },
	};

	static const shell_command_t sSwitchOnOffSubCommands[] = {
		{ &Unicast::OnOffHelpHandler, "help", "Usage : switch ononff [on|off|toggle]" },
		{ &Unicast::OnCommandHandler, "on", "Sends on command to bound lighting app" },
		{ &Unicast::OffCommandHandler, "off", "Sends off command to bound lighting app" },
		{ &Unicast::ToggleCommandHandler, "toggle", "Sends toggle command to bound lighting app" }
	};

	static const shell_command_t sSwitchGroupsSubCommands[] = {
		{ &Group::SwitchHelpHandler, "help", "switch a group of bounded lightning apps" },
		{ &Group::OnOffCommandHandler, "onoff", "Usage: switch groups onoff [on|off|toggle]" }
	};

	static const shell_command_t sSwichGroupsOnOffSubCommands[] = {
		{ &Group::OnOffHelpHandler, "help", "Usage: switch groups onoff [on|off|toggle]" },
		{ &Group::OnCommandHandler, "on", "Sends on command to bound Group" },
		{ &Group::OffCommandHandler, "off", "Sends off command to bound Group" },
		{ &Group::ToggleCommandHandler, "toggle", "Sends toggle command to bound Group" }
	};

	static const shell_command_t sSwitchCommand = { &SwitchCommandHandler, "switch",
							"Light-switch commands. Usage: switch [onoff|groups]" };

	sShellSwitchGroupsOnOffSubCommands.RegisterCommands(sSwichGroupsOnOffSubCommands,
							    MATTER_ARRAY_SIZE(sSwichGroupsOnOffSubCommands));
	sShellSwitchOnOffSubCommands.RegisterCommands(sSwitchOnOffSubCommands,
						      MATTER_ARRAY_SIZE(sSwitchOnOffSubCommands));
	sShellSwitchGroupsSubCommands.RegisterCommands(sSwitchGroupsSubCommands,
						       MATTER_ARRAY_SIZE(sSwitchGroupsSubCommands));
	sShellSwitchSubCommands.RegisterCommands(sSwitchSubCommands, MATTER_ARRAY_SIZE(sSwitchSubCommands));

	Engine::Root().RegisterCommands(&sSwitchCommand, 1);
}

} /* namespace SwitchCommands */
#endif
```
